## sdkconfig.defaults
```kconfig
CONFIG_FREERTOS_HZ=1000

CONFIG_ESPTOOLPY_FLASHSIZE_4MB=y

CONFIG_PARTITION_TABLE_CUSTOM=y
CONFIG_PARTITION_TABLE_CUSTOM_FILENAME="partitions.csv"
CONFIG_PARTITION_TABLE_FILENAME="partitions.csv"

CONFIG_ESP_TLS_INSECURE=y
CONFIG_ESP_TLS_SKIP_SERVER_CERT_VERIFY=y

CONFIG_HAGL_HAL_USE_DOUBLE_BUFFERING=y
CONFIG_MIPI_DCS_ADDRESS_MODE_MIRROR_Y=0x00
CONFIG_MIPI_DCS_ADDRESS_MODE_MIRROR_X=0x40
CONFIG_MIPI_DCS_ADDRESS_MODE_SWAP_XY=0x20
CONFIG_MIPI_DCS_ADDRESS_MODE_FLIP_X=0x00
CONFIG_MIPI_DCS_ADDRESS_MODE_FLIP_Y=0x00
CONFIG_MIPI_DCS_PIXEL_FORMAT_16BIT_SELECTED=y
CONFIG_MIPI_DISPLAY_PIXEL_FORMAT=0x55
CONFIG_MIPI_DISPLAY_WIDTH=160
CONFIG_MIPI_DISPLAY_HEIGHT=128
CONFIG_MIPI_DISPLAY_OFFSET_X=0
CONFIG_MIPI_DISPLAY_OFFSET_Y=0
CONFIG_MIPI_DCS_ADDRESS_MODE_BGR_SELECTED=y
CONFIG_MIPI_DCS_ADDRESS_MODE_BGR=0x08
CONFIG_MIPI_DISPLAY_SPI_CLOCK_SPEED_HZ=40000000
CONFIG_MIPI_DISPLAY_PIN_MISO=9
CONFIG_MIPI_DISPLAY_PIN_MOSI=10
CONFIG_MIPI_DISPLAY_PIN_CLK=8
CONFIG_MIPI_DISPLAY_PIN_CS=20
CONFIG_MIPI_DISPLAY_PIN_DC=2
CONFIG_MIPI_DISPLAY_PIN_RST=-1
CONFIG_MIPI_DISPLAY_PIN_BL=-1
```
